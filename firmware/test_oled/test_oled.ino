/*
 * ===============================================================================
 *  AgriStack — Standalone SSD1306 OLED (128x64) I2C Hardware Tester
 * ===============================================================================
 *  Zero external libraries needed! Uses ONLY built-in <Wire.h>.
 *
 *  ESP32 Pin Connections:
 *   - GND -> GND
 *   - VCC -> 3.3V (or 5V)
 *   - SDA -> GPIO 21
 *   - SCL -> GPIO 22
 * ===============================================================================
 */

#include <Wire.h>

#define PIN_I2C_SDA  21
#define PIN_I2C_SCL  22
#define PIN_LED      2

// Standard 5x7 ASCII Font Table
const uint8_t PROGMEM FONT_5X7[] = {
  0x00, 0x00, 0x00, 0x00, 0x00, // Space
  0x00, 0x00, 0x5F, 0x00, 0x00, // !
  0x00, 0x07, 0x00, 0x07, 0x00, // "
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  0x08, 0x04, 0x08, 0x10, 0x08  // ~
};

class SimpleSSD1306 {
private:
  uint8_t _addr;
  uint8_t _buffer[1024];

  void sendCommand(uint8_t cmd) {
    Wire.beginTransmission(_addr);
    Wire.write(0x00);
    Wire.write(cmd);
    Wire.endTransmission();
  }

public:
  SimpleSSD1306(uint8_t addr = 0x3C) : _addr(addr) {}

  void setAddress(uint8_t addr) { _addr = addr; }

  bool begin() {
    Wire.beginTransmission(_addr);
    if (Wire.endTransmission() != 0) return false;

    sendCommand(0xAE); // Display OFF
    sendCommand(0xD5); sendCommand(0x80); // Clock divide
    sendCommand(0xA8); sendCommand(0x3F); // Multiplex 64
    sendCommand(0xD3); sendCommand(0x00); // Offset 0
    sendCommand(0x40); // Start line 0
    sendCommand(0x8D); sendCommand(0x14); // Enable charge pump
    sendCommand(0x20); sendCommand(0x00); // Horizontal mode
    sendCommand(0xA1); // Segment remap
    sendCommand(0xC8); // COM scan reverse
    sendCommand(0xDA); sendCommand(0x12); // COM pins
    sendCommand(0x81); sendCommand(0xCF); // Contrast
    sendCommand(0xD9); sendCommand(0xF1); // Pre-charge
    sendCommand(0xDB); sendCommand(0x40); // VCOM detect
    sendCommand(0xA4); // Output follows RAM
    sendCommand(0xA6); // Normal display
    sendCommand(0xAF); // Display ON

    clear();
    display();
    return true;
  }

  void clear() {
    memset(_buffer, 0, sizeof(_buffer));
  }

  void drawPixel(int x, int y, bool color = true) {
    if (x < 0 || x >= 128 || y < 0 || y >= 64) return;
    if (color) {
      _buffer[x + (y / 8) * 128] |= (1 << (y % 8));
    } else {
      _buffer[x + (y / 8) * 128] &= ~(1 << (y % 8));
    }
  }

  void drawChar(int x, int y, char c) {
    if (c < 32 || c > 126) c = '?';
    int fontIdx = (c - 32) * 5;
    for (int col = 0; col < 5; col++) {
      uint8_t line = pgm_read_byte(&FONT_5X7[fontIdx + col]);
      for (int bit = 0; bit < 7; bit++) {
        drawPixel(x + col, y + bit, (line >> bit) & 0x01);
      }
    }
  }

  void drawString(int x, int y, const String &str) {
    int curX = x;
    for (size_t i = 0; i < str.length(); i++) {
      drawChar(curX, y, str[i]);
      curX += 6;
      if (curX > 122) break;
    }
  }

  void drawHLine(int y) {
    for (int x = 0; x < 128; x++) {
      drawPixel(x, y, true);
    }
  }

  void drawRect(int x, int y, int w, int h) {
    for (int i = x; i < x + w; i++) {
      drawPixel(i, y, true);
      drawPixel(i, y + h - 1, true);
    }
    for (int j = y; j < y + h; j++) {
      drawPixel(x, j, true);
      drawPixel(x + w - 1, j, true);
    }
  }

  void display() {
    for (uint8_t page = 0; page < 8; page++) {
      sendCommand(0xB0 + page);
      sendCommand(0x00);
      sendCommand(0x10);

      for (uint8_t col = 0; col < 128; col += 16) {
        Wire.beginTransmission(_addr);
        Wire.write(0x40);
        for (uint8_t k = 0; k < 16; k++) {
          Wire.write(_buffer[(page * 128) + col + k]);
        }
        Wire.endTransmission();
      }
    }
  }
};

SimpleSSD1306 oled(0x3C);
uint8_t detectedAddr = 0;

void setup() {
  Serial.begin(115200);
  delay(1000);
  pinMode(PIN_LED, OUTPUT);

  Serial.println("\n==========================================");
  Serial.println("   AGRISTACK SSD1306 OLED TEST PROGRAM    ");
  Serial.println("==========================================");

  Wire.begin(PIN_I2C_SDA, PIN_I2C_SCL);

  // Scan I2C
  Serial.println("[I2C] Scanning for OLED display...");
  for (uint8_t addr = 1; addr < 127; addr++) {
    Wire.beginTransmission(addr);
    if (Wire.endTransmission() == 0) {
      Serial.printf("  [✓] Detected device at address: 0x%02X\n", addr);
      if (addr == 0x3C || addr == 0x3D) {
        detectedAddr = addr;
      }
    }
  }

  if (detectedAddr != 0) {
    oled.setAddress(detectedAddr);
    if (oled.begin()) {
      Serial.printf("[OLED] SSD1306 initialized successfully at 0x%02X!\n", detectedAddr);
    }
  } else {
    Serial.println("[!] OLED not detected on 0x3C/0x3D. Retrying address 0x3C anyway...");
    oled.begin();
  }
}

int count = 0;

void loop() {
  count++;
  digitalWrite(PIN_LED, !digitalRead(PIN_LED));

  oled.clear();

  // Draw Box border
  oled.drawRect(0, 0, 128, 64);

  // Title
  oled.drawString(10, 4, "AGRISTACK OLED TEST");
  oled.drawHLine(14);

  // Stats
  oled.drawString(8, 20, "STATUS: ONLINE [OK]");
  oled.drawString(8, 30, "I2C ADDR: 0x3C");
  oled.drawString(8, 40, "PULSE COUNT: #" + String(count));

  oled.drawHLine(50);
  oled.drawString(16, 54, "SSD1306 128x64");

  oled.display();

  Serial.printf("[TEST] OLED Refresh #%d (I2C: 0x3C)\n", count);
  delay(1000);
}
